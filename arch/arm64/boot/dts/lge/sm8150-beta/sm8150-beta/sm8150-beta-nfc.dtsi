/*
 * Copyright (c) 2018, The Linux Foundation. All rights reserved.
 *
 * This program is free software; you can redistribute it and/or modify
 * it under the terms of the GNU General Public License version 2 and
 * only version 2 as published by the Free Software Foundation.
 *
 * This program is distributed in the hope that it will be useful,
 * but WITHOUT ANY WARRANTY; without even the implied warranty of
 * MERCHANTABILITY or FITNESS FOR A PARTICULAR PURPOSE.  See the
 * GNU General Public License for more details.
 */

#include "../sm8150-beta_common/sm8150-beta_common-nfc.dtsi"


&qupv3_se9_i2c { /* QUP_9 (NFC) */
	qcom,clk-freq-out = <1000000>;
	status = "ok";
	nq@28 {
		status = "disabled";
	};

	pn547@28 {
		compatible = "nxp,pn547";
		reg = <0x28>;
		status = "ok";
		nxp,gpio_sda = <&tlmm 39 0x00>;
		nxp,gpio_scl = <&tlmm 40 0x00>;
		nxp,gpio_ven = <&tlmm 41 0x00>;
		nxp,gpio_mode = <&tlmm 113 0x00>;
		nxp,gpio_irq = <&tlmm 47 0x00>;
		nxp,i2c-pull-up = <1>;
		qcom,clk-src = "BBCLK2";
		interrupt-parent = <&tlmm>;
		interrupts = <47 0>;
		interrupt-names = "nfc_irq";
	};
};
