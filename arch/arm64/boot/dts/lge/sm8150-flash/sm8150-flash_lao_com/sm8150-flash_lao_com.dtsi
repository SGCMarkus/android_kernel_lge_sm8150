/*
 * Copyright (c) 2018, The Linux Foundation. All rights reserved.
 *
 * This program is free software; you can redistribute it and/or modify
 * it under the terms of the GNU General Public License version 2 and
 * only version 2 as published by the Free Software Foundation.
 *
 * This program is distributed in the hope that it will be useful,
 * but WITHOUT ANY WARRANTY; without even the implied warranty of
 * MERCHANTABILITY or FITNESS FOR A PARTICULAR PURPOSE.  See the
 * GNU General Public License for more details.
 */

#include <dt-bindings/input/input.h>
#include <dt-bindings/gpio/gpio.h>
#include <dt-bindings/clock/qcom,gcc-sm8150.h>
#include <dt-bindings/clock/qcom,camcc-sm8150.h>
#include <dt-bindings/clock/qcom,rpmh.h>
#include <dt-bindings/interrupt-controller/arm-gic.h>

#include "../sm8150-flash_common/sm8150-flash_common.dtsi"
#include "sm8150-flash_lao_com-pinctrl.dtsi"
#include "sm8150-flash_lao_com-panel.dtsi"
#include "sm8150-flash_lao_com-misc.dtsi"
#include "sm8150-flash_lao_com-pm.dtsi"
#include "sm8150-flash_lao_com-connectivity.dtsi"
#include "sm8150-flash_lao_com-nfc.dtsi"
#include "sm8150-flash_lao_com-mme.dtsi"
#include "sm8150-flash_lao_com-touch.dtsi"
#include "sm8150-flash_lao_com-usb.dtsi"
#include "sm8150-flash_lao_com-storage.dtsi"
#include "sm8150-flash_lao_com-5G_modem.dtsi"
