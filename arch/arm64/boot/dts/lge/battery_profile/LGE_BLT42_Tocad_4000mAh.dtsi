
qcom,LGE_BLT42_Tocad_4000mAh {
	/* #3785476_LGE_BLT42mp_4000mAh_averaged_MasterSlave_Jan4th2019*/
	qcom,max-voltage-uv = <4430000>;
	qcom,fg-cc-cv-threshold-mv = <4430>;
	qcom,fastchg-current-ma = <3300>;
	qcom,batt-id-kohm = <91>;
	qcom,battery-type = "LGE_BLT42_Tocad_4000mAh";
	qcom,therm-coefficients = <0x230d 0xcf0 0x42 0xccbe 0x81ca>;
	qcom,therm-center-offset = <0x5b>;
	qcom,therm-pull-up = <100>;
	qcom,rslow-normal-coeffs = <0xd7 0x0d 0xeb 0x0b>;
	qcom,rslow-low-coeffs = <0xd8 0x14 0xfb 0x05>;
	qcom,checksum = <0x31EB>;
	qcom,gui-version = "PM855GUI - 1.0.0.13";
	qcom,fg-profile-data = [
		 09 00 FF E3
		 F1 07 96 DA
		 B3 D5 00 00
		 A1 BD A3 8A
		 F8 87 84 92
		 9E 94 23 80
		 1D 00 D7 0D
		 EB 0B E6 04
		 32 02 CE 07
		 32 00 34 EB
		 86 ED F9 CC
		 4A 12 19 E2
		 1B C5 57 FD
		 1D 02 24 DA
		 60 00 43 00
		 4B 00 4A 00
		 36 00 31 00
		 36 00 41 00
		 41 00 45 00
		 3D 00 60 00
		 2D 00 3A 00
		 45 00 3D 00
		 38 00 68 00
		 55 64 49 00
		 46 00 44 08
		 60 00 44 00
		 4A 00 71 10
		 59 10 4B 00
		 91 28 6E 48
		 5A 60 4B 0D
		 4F 00 D8 00
		 28 20 90 0C
		 72 03 65 05
		 64 1C 84 0B
		 72 0D DC 2A
		 83 17 48 42
		 6A 5D 09 02
		 68 10 D4 1F
		 32 05 F4 0A
		 D1 FD E2 1C
		 F6 01 CD 05
		 9F 0A B4 17
		 01 22 1A 44
		 98 5A 76 10
		 7D 1F AA E5
		 95 C2 53 CC
		 D8 1C C6 D1
		 A6 04 06 BA
		 AD 17 DF 8B
		 58 84 5C 9A
		 7B A0 09 80
		 D2 03 66 04
		 1E 05 5A FA
		 00 F8 99 DD
		 FC E2 F6 07
		 63 CB 9B BC
		 69 18 13 F8
		 9D D6 CB 02
		 03 06 BB 02
		 CE 07 32 00
		 E1 02 B2 02
		 F9 04 BF 00
		 40 05 F2 02
		 6A 02 4D 02
		 9A 04 57 00
		 37 00 41 00
		 44 64 49 00
		 48 00 46 08
		 48 00 46 00
		 47 00 3F 10
		 3C 10 3C 00
		 4F 28 50 48
		 5B 60 69 0C
		 48 00 54 00
		 5C 08 63 00
		 4C 00 3D 00
		 44 10 53 10
		 4C 00 61 20
		 74 48 48 58
		 5A 0E 5F 00
		 5B 00 3C 08
		 D8 00 E9 20
		 5A 04 69 0B
		 70 0D D3 1C
		 33 23 E1 45
		 37 5A 56 18
		 42 02 3A 05
		 5C 02 72 10
		 3F 0A 1A 20
		 10 05 0D 03
		 B0 05 C2 1C
		 35 03 C3 05
		 7F 02 8B 18
		 D1 03 EB 05
		 27 03 68 00
		 99 1F 94 05
		 BA 02 F5 05
		 CE 1C A4 02
		 9C 04 E7 03
		 A0 18 4D 03
		 D8 04 18 02
		 6A 00 4E 01
		 C0 00 FA 00
		 BB 0F 00 00
	];
};
