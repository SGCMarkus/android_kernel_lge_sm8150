/*
 * Copyright (c) 2018, The Linux Foundation. All rights reserved.
 *
 * This program is free software; you can redistribute it and/or modify
 * it under the terms of the GNU General Public License version 2 and
 * only version 2 as published by the Free Software Foundation.
 *
 * This program is distributed in the hope that it will be useful,
 * but WITHOUT ANY WARRANTY; without even the implied warranty of
 * MERCHANTABILITY or FITNESS FOR A PARTICULAR PURPOSE.  See the
 * GNU General Public License for more details.
 */

#include "../sm8150-mh2lm_common/sm8150-mh2lm_common-pm.dtsi"

&pm8150b_charger {
	qcom,hvdcp-disable;
};

&qupv3_se0_i2c {
	idtp9222-charger@61 {
		// FOD parameters
		idt,fod-bpp    = [A5 28 88 2E 98 19 A3 03 A1 FB A8 E8];
		idt,fod-epp    = [FF FF 88 44 86 4B 96 19 97 0A 9C E7];
	};
};

