/*
 * Copyright (c) 2018, The Linux Foundation. All rights reserved.
 *
 * This program is free software; you can redistribute it and/or modify
 * it under the terms of the GNU General Public License version 2 and
 * only version 2 as published by the Free Software Foundation.
 *
 * This program is distributed in the hope that it will be useful,
 * but WITHOUT ANY WARRANTY; without even the implied warranty of
 * MERCHANTABILITY or FITNESS FOR A PARTICULAR PURPOSE.  See the
 * GNU General Public License for more details.
 */

#include <dt-bindings/input/input.h>
#include <dt-bindings/gpio/gpio.h>
#include <dt-bindings/clock/qcom,gcc-sm8150.h>
#include <dt-bindings/clock/qcom,camcc-sm8150.h>
#include <dt-bindings/clock/qcom,rpmh.h>
#include <dt-bindings/interrupt-controller/arm-gic.h>

#include "../sm8150-mh2lm_common/sm8150-mh2lm_common.dtsi"
#include "sm8150-mh2lm_sb_jp-pinctrl.dtsi"
#include "sm8150-mh2lm_sb_jp-panel.dtsi"
#include "sm8150-mh2lm_sb_jp-misc.dtsi"
#include "sm8150-mh2lm_sb_jp-pm.dtsi"
#include "sm8150-mh2lm_sb_jp-connectivity.dtsi"
#include "sm8150-mh2lm_sb_jp-nfc.dtsi"
#include "sm8150-mh2lm_sb_jp-mme.dtsi"
#include "sm8150-mh2lm_sb_jp-touch.dtsi"
#include "sm8150-mh2lm_sb_jp-usb.dtsi"
#include "sm8150-mh2lm_sb_jp-storage.dtsi"
#include "sm8150-mh2lm_sb_jp-pkm.dtsi"
#include "sm8150-mh2lm_sb_jp-flicker.dtsi"
#include "sm8150-mh2lm_sb_jp-isdbt.dtsi"