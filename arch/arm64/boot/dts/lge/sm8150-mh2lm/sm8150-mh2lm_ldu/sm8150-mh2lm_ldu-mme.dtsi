/*
 * Copyright (c) 2018, The Linux Foundation. All rights reserved.
 *
 * This program is free software; you can redistribute it and/or modify
 * it under the terms of the GNU General Public License version 2 and
 * only version 2 as published by the Free Software Foundation.
 *
 * This program is distributed in the hope that it will be useful,
 * but WITHOUT ANY WARRANTY; without even the implied warranty of
 * MERCHANTABILITY or FITNESS FOR A PARTICULAR PURPOSE.  See the
 * GNU General Public License for more details.
 */

&soc {
	lge-mme-bus {
		compatible = "lge,mme_bus";
		lge,app-names = "mme";
	};
	lge-mme {
		compatible = "lge-mme";
		lge-mme,gpio_sleep_n = <&tlmm 92 0>;
		lge-mme,gpio_ph = <&tlmm 93 0>;
		lge-mme,gpio_en = <&tlmm 94 0>;
	};
};
