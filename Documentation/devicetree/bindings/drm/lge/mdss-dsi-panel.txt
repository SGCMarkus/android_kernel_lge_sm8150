## drivers/broadcast/Kconfig
```kconfig
# LGE Broadcast Device Driver Support

menu "LGE Broadcast Device Support"

config LGE_BROADCAST_TDMB
    bool "LGE broadcast TDMB device Driver"
    depends on (MACH_LGE)
    default n
    help
      Select this if you want to use TDMB broadcast service

config LGE_BROADCAST_ISDBT_JAPAN
    bool "Japan full-seg Broadcast service"
    depends on (MACH_LGE)
    default n
    help
      Select this if you want to use Japanese FullSeg mobile broadcast service

source "drivers/broadcast/oneseg/Kconfig"

# MTK Core
#source "drivers/misc/mediatek/broadcast/tdmb/Kconfig"

# QCOM Core
source "drivers/broadcast/tdmb/Kconfig"

endmenu
```

## drivers/bus/mhi/controllers/Kconfig
```kconfig
menu "MHI controllers"

config MHI_QCOM
       tristate "MHI QCOM"
       depends on MHI_BUS
       help
	  If you say yes to this option, MHI bus support for QCOM modem chipsets
	  will be enabled.
config LGE_DUAL_QFUSE
       tristate "LGE DUAL QFUSE"
       depends on MHI_BUS
       help
	  If you say yes to this option, sbl_fuse.mbn modified by LGE will be loaded
	  when we want fusing to modem.
endmenu
```

## drivers/ice40/Kconfig
```kconfig
#
# ice40 devices
#

if HAS_IOMEM
menu "ice40 device drivers"

config LATTICE_CORE
	tristate
	select IRQ_DOMAIN
	default n

config LATTICE_ICE40
	bool "LATTICE ICE40"
	select LATTICE_CORE
	select REGMAP_I2C
	select REGMAP_IRQ
	depends on I2C=y
	help
	  Support for the ICE40 accessory communication interface IC
endmenu
endif
```

## drivers/input/fingerprint/Kconfig
```kconfig
#
# Fingerprints driver configuration
#
menuconfig INPUT_FINGERPRINT
	bool "FingerPrints"
	help
	  Say Y here, and a list of supported fingerprints will be displayed.
	  This option doesn't affect the kernel.

	  If unsure, say Y.

if INPUT_FINGERPRINT
config INPUT_IX_BTP
       tristate "IX fingerprint sensor support"
       depends on SPI_MASTER

endif

config FINGERPRINT_GOODIX_GF3208
        tristate "Goodix GF3208 fingerprint drvier support"
	help
          Say Y here to enable goodix fingerprint driver support
          
config BBK_ET713
	tristate "Egis ET713 fingerprint drvier support"
	help
	  Say Y here to enable et713 fingerprint driver support!
```

## drivers/input/misc/tcs3407/Kconfig
```kconfig
config SENSORS_TCS3407
	tristate "AMS TCS3407 MoBeam, RemCon, ALS, Proximity, Color, Flicker sensor"
	depends on I2C && SYSFS
	help
	  If you say yes here you get support for the AMS TCS3407
	  mobeam, ambient light, proximity, color, and flicker sensors.

	  This driver can also be built as a module.  If so, the module
	  will be called TCS3407.

config TCS3407_AMS_DEBUG_LOG
    bool "Enable debug logging"
    depends on SENSORS_TCS3407
    default y

config TCS3407_AMS_OPTICAL_SENSOR_ALS
    bool "Enable Ambient Light and Color Sensor Support"
    depends on SENSORS_TCS3407
    default y

config TCS3407_AMS_OPTICAL_SENSOR_FLICKER
    bool "Enable Flicker Sensor Support"
    depends on TCS3407_AMS_OPTICAL_SENSOR_ALS
    default y

config TCS3407_AMS_OPTICAL_SENSOR_PROX
    bool "Enable Proximity Sensor Support"
    depends on SENSORS_TCS3407
    default y
```

## drivers/input/touchscreen/lge/Kconfig
```kconfig
#
# LGE touch core configuration
#

if INPUT_TOUCHSCREEN

menuconfig LGE_TOUCH_CORE
	bool "LGE Touch Core - Generic"
	select LGE_TOUCH_CORE_BASE
	help
	  If your plaform is generic linux, say Y

menuconfig LGE_TOUCH_CORE_MTK
	bool "LGE Touch Core - MTK"
	select LGE_TOUCH_CORE_BASE
	help
	  If your plaform is mtk linux, say Y

menuconfig LGE_TOUCH_CORE_QCT
	bool "LGE Touch Core - QCT"
	select LGE_TOUCH_CORE_BASE
	help
	  If your plaform is qct linux, say Y

config LGE_TOUCH_CORE_BASE
	bool "LGE Touch Core Base"
	depends on SPI_MASTER && I2C

config LGE_TOUCH_FW_PATH
	string "LGE Touch Core Firmware Path"
	help
	LGE_TOUCH_FW_PATH is set to path of touch firmware

config LGE_TOUCH_MODULE_DETECT
	bool "LGE Touch Core - Enable Module detection"
	select LGE_TOUCH_CORE_BASE
	default n
	help
	Feature for read device maker id, like lcd or touch maker

config SECURE_TOUCH
	bool "Secure Touch"
	help
	If touch dualization is applied, say Y

config LGE_TOUCH_USE_PANEL_NOTIFY
	bool "Use lge_panel_notify.h"
	help
	If you use lge_panel_notify.h, say Y

config LGE_TOUCH_MODULE_SW49106
	tristate "SiW SW49106 module"
	depends on I2C
	default n
	help
	If you want to test touch module for 2nd input driver, yes 'm' here

config LGE_TOUCH_MODULE_S3706
	tristate "Synaptics S3706 module"
	depends on I2C
	default n
	help
	If you want to test touch module for 2nd input driver, yes 'm' here

config LGE_TOUCH_MODULE_FT3518
	tristate "Focaltech FT3518 module"
	depends on I2C
	default n
	help
	If you want to test touch module for 2nd input driver, yes 'm' here

source "drivers/input/touchscreen/lge/lgsic/Kconfig"
source "drivers/input/touchscreen/lge/stm/Kconfig"
source "drivers/input/touchscreen/lge/synaptics/Kconfig"
source "drivers/input/touchscreen/lge/focaltech/Kconfig"
endif
```

## drivers/input/touchscreen/lge/focaltech/FT3518/Kconfig
```kconfig
#
# LGE touch core configuration
#

if INPUT_TOUCHSCREEN

menuconfig LGE_TOUCH_FOCALTECH_FT3518
	bool "LGE Touch Core ODM Device Driver - FT3518"
	depends on LGE_TOUCH_CORE_BASE
	help
	  If your device is ft3518, say Y

endif
```

## drivers/input/touchscreen/lge/focaltech/Kconfig
```kconfig
#
# LGE touch core configuration
#

if INPUT_TOUCHSCREEN
source "drivers/input/touchscreen/lge/focaltech/FT3518/Kconfig"
endif
```

## drivers/input/touchscreen/lge/lgsic/Kconfig
```kconfig
#
# LGE touch core configuration
#
if INPUT_TOUCHSCREEN

menuconfig LGE_TOUCH_LGSIC_LG4945
	bool "LGE Touch Core ODM Device Driver - LG4945"
	depends on LGE_TOUCH_CORE_BASE
	help
	  If your device is lg4945, say Y

menuconfig LGE_TOUCH_LGSIC_LG4946
	bool "LGE Touch Core ODM Device Driver - LG4946"
	depends on LGE_TOUCH_CORE_BASE
	help
	  If your device is lg4946, say Y

menuconfig LGE_TOUCH_LGSIC_SW49407
        bool "LGE Touch Core ODM Device Driver - SW49407"
        depends on LGE_TOUCH_CORE_BASE
        help
          If your device is sw49407, say Y

menuconfig LGE_TOUCH_LGSIC_SW49408
        bool "LGE Touch Core ODM Device Driver - SW49408"
        depends on LGE_TOUCH_CORE_BASE
        help
          If your device is sw49408, say Y

menuconfig LGE_TOUCH_LGSIC_SW49409
        bool "LGE Touch Core ODM Device Driver - SW49409"
        depends on LGE_TOUCH_CORE_BASE
        help
          If your device is sw49409, say Y

menuconfig LGE_TOUCH_LGSIC_SW49410
        bool "LGE Touch Core ODM Device Driver - SW49410"
        depends on LGE_TOUCH_CORE_BASE
        help
          If your device is sw49410, say Y

menuconfig LGE_TOUCH_LGSIC_SW42000
        bool "LGE Touch Core ODM Device Driver - SW42000"
        depends on LGE_TOUCH_CORE_BASE
        help
          If your device is sw42000, say Y

# To Do : LGSIC Chipseet
endif
```

## drivers/input/touchscreen/lge/stm/Kconfig
```kconfig
#
# LGE touch core configuration
#
if INPUT_TOUCHSCREEN

menuconfig LGE_TOUCH_STM_FTM4
	bool "LGE Touch Core ODM Device Driver - STM(FTM4)"
	depends on LGE_TOUCH_CORE_BASE
	help
	  If your device is STM(FTM4), say Y

endif
```

## drivers/input/touchscreen/lge/synaptics/Kconfig
```kconfig
#
# LGE touch core configuration
#

if INPUT_TOUCHSCREEN

menuconfig LGE_TOUCH_SYNAPTICS_S3618
	bool "LGE Touch Core ODM Device Driver - Synaptics(s3618)"
	depends on LGE_TOUCH_CORE_BASE
	help
	  If your device is synaptics(s3618), say Y

menuconfig LGE_TOUCH_SYNAPTICS_S3706
	bool "LGE Touch Core ODM Device Driver - Synaptics(s3706)"
	depends on LGE_TOUCH_CORE_BASE
	help
	  If your device is synaptics(s3707), say Y

menuconfig LGE_TOUCH_SYNAPTICS_S3706_MH2
	bool "LGE Touch Core ODM Device Driver - Synaptics(s3706)"
	depends on LGE_TOUCH_CORE_BASE
	help
	  If your device is synaptics(s3706), say Y

menuconfig LGE_TOUCH_SYNAPTICS_S3707
	bool "LGE Touch Core ODM Device Driver - Synaptics(s3707)"
	depends on LGE_TOUCH_CORE_BASE
	help
	  If your device is synaptics(s3707), say Y

endif
```

## drivers/nfc/cxd22xx/Kconfig
```kconfig
#
# Near Field Communication (NFC) devices
#

config NFC_CXD22XX
        tristate "CXD22XX NFC driver"
        depends on I2C
        select CRC_CCITT
        default n
        ---help---
          Say yes if you want Sony cxd22xx Near Field Communication driver.
          This is for i2c connected version. If unsure, say N here.

          To compile this driver as a module, choose m here. The module will
          be called cxd22xx-i2c.

config NFC_CXD22XX_VEN
        bool "CXD224X NFC VEN"
        depends on NFC_CXD22XX
        default n
        ---help---
          Say yes if you want to use cxd22xx NFC VEN(enable voltage) control.
          If unsure, say N here.

config NFC_CXD22XX_RST
        bool "CXD22XX NFC RST"
        depends on NFC_CXD22XX
        default y
        ---help---
          Say yes if you want to use cxd22xx NFC RST(external XRST pin) control.

config NFC_CXD22XX_PM
        bool "CXD22XX PM"
        depends on NFC_CXD22XX && PM_SLEEP
        default n
        ---help---
          Say yes if you want to enable cxd22xx suspend/resume function.

config NFC_CXD22XX_SERVICE_MODE
    tristate "CXD22XX NFC Service Mode"
    depends on NFC_CXD22XX
    default n
    ---help---
      Say yes if you want to use cxd224x NFC Service Mode control.
```

## drivers/nfc/pn553/Kconfig
```kconfig
#
# Nxp Nci protocol (I2C) devices
#

#config NFC_PN553_DEVICES
#	bool "Nxp pn553 NCI protocol driver (I2C) devices"
#	default y
#	---help---
#	  You'll have to say Y if your computer contains an I2C device that
#	  you want to use under Linux.
#
#	  You can say N here if you don't have any SPI connected to your computer.

### LGE_START ###

config LGE_NFC
	bool "NFC Device Enabled for LGE"
	default n

config LGE_NFC_PN553
	bool "PN553 NFC driver"
	depends on I2C
	select CRC_CCITT
	default n
	---help---
	  Say yes if you want PN553 Near Field Communication driver.
	  This is for i2c connected version. If unsure, say N here.

	  To compile this driver as a module, choose m here. The module will
	  be called pn553.

config LGE_NFC_SET_IRQ_WAKEUP
	bool "NFC Set IRQ wakeup when NFC ON"
	default n
	---help---
	  Say yes if Set IRQ Wakeup NFC ON.
	  If unsure, say N here.

config LGE_NFC_DEBUG_MESSAGE
	bool "NFC Debug Message"
	default n

### LGE_END ###
```
